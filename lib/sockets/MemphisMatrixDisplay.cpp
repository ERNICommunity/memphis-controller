/*
 * MemphisMatrixDisplay.cpp
 *
 *  Created on: 29.05.2016
 *      Author: niklausd
 */

#include <Adafruit_GFX.h>
#include <gfxfont.h>
#include <Fonts/TomThumb.h>
#include <Adafruit_NeoPixel.h>
#include <Adafruit_NeoMatrix.h>
#include <DbgCliTopic.h>
#include <DbgCliNode.h>
#include <DbgCliCommand.h>
#include <Timer.h>
#include <CmdSequence.h>
#include <CmdAdapter.h>
#include <Cmd.h>
#include <MemphisMatrixDisplay.h>

//-----------------------------------------------------------------------------

class MatrixDbgCmd_SelImage : public DbgCli_Command
{
private:
  MemphisMatrixDisplay* m_matrix;

public:
  MatrixDbgCmd_SelImage(MemphisMatrixDisplay* matrix)
  : DbgCli_Command(matrix->getCliTopicMatrix(), "selimg", "Select Image to be displayed.")
  , m_matrix(matrix)
  { }

  virtual ~MatrixDbgCmd_SelImage() { }

  void execute(unsigned int argc, const char** args, unsigned int idxToFirstArgToHandle)
  {
    if (0 != m_matrix)
    {
      if (argc - idxToFirstArgToHandle == 0)
      {
        Serial.print("Selected Image to be shown on Display is ");
        Serial.println(m_matrix->selectedImage());
      }
      else if (argc - idxToFirstArgToHandle == 1)
      {
        unsigned int img = atoi(args[idxToFirstArgToHandle]);
        m_matrix->selectImage(img);
        Serial.print("Selected Image to be shown on Display is ");
        Serial.println(m_matrix->selectedImage());
      }
      else
      {
        printUsage();
      }
    }
  }

  void printUsage()
  {
    Serial.println("");
    Serial.println(getHelpText());
    Serial.println("");
    Serial.println("usage: dbg matrix selimg [<image>]");
    Serial.println("");
    Serial.println("           image  Image to be shown (0: blank (power off), 1: Arkathon Heart, 2: ERNI Heart, 3: SBB Heart)");
    Serial.println("                  optional parameter, shows currently shown image if omitted");
    Serial.println("");
  }

private:  // forbidden functions
  MatrixDbgCmd_SelImage();                                              // default constructor
  MatrixDbgCmd_SelImage(const MatrixDbgCmd_SelImage& src);              // copy constructor
  MatrixDbgCmd_SelImage& operator = (const MatrixDbgCmd_SelImage& src); // assignment operator
};

//-----------------------------------------------------------------------------

class MatrixDbgCmd_RunSequence : public DbgCli_Command
{
private:
  MemphisMatrixDisplay* m_matrix;

public:
  MatrixDbgCmd_RunSequence(MemphisMatrixDisplay* matrix)
  : DbgCli_Command(matrix->getCliTopicMatrix(), "runseq", "Start or stop the Image Sequence.")
  , m_matrix(matrix)
  { }

  virtual ~MatrixDbgCmd_RunSequence() { }

  void execute(unsigned int argc, const char** args, unsigned int idxToFirstArgToHandle)
  {
    if ((0 != m_matrix) && (0 != m_matrix->imageSequence()))
    {
      if (argc - idxToFirstArgToHandle == 0)
      {
        Serial.print("The Image Sequence is ");
        Serial.println(m_matrix->imageSequence()->isRunning() ? "running." : "not running.");
      }
      else if (argc - idxToFirstArgToHandle == 1)
      {
        bool runSequence = atoi(args[idxToFirstArgToHandle]);
        Serial.print("The Image Sequence is ");
        Serial.println(runSequence ? "running." : "not running.");
        if (runSequence)
        {
          m_matrix->imageSequence()->start();
        }
        else
        {
          m_matrix->imageSequence()->stop();
        }
      }
      else
      {
        printUsage();
      }
    }
  }

  void printUsage()
  {
    Serial.println("");
    Serial.println(getHelpText());
    Serial.println("");
    Serial.println("usage: dbg matrix runseq [{0|1}]");
    Serial.println("");
    Serial.println("           0:  Image Sequence not running");
    Serial.println("           1:  Image Sequence running");
    Serial.println("               optional parameter, shows current state if omitted");
    Serial.println("");
  }

private:  // forbidden functions
  MatrixDbgCmd_RunSequence();                                                     // default constructor
  MatrixDbgCmd_RunSequence(const MatrixDbgCmd_RunSequence& src);              // copy constructor
  MatrixDbgCmd_RunSequence& operator = (const MatrixDbgCmd_RunSequence& src); // assignment operator
};

//-----------------------------------------------------------------------------

class MatrixDbgCmd_TxtEna : public DbgCli_Command
{
private:
  MemphisMatrixDisplay* m_matrix;

public:
  MatrixDbgCmd_TxtEna(MemphisMatrixDisplay* matrix)
  : DbgCli_Command(matrix->getCliTopicMatrix(), "txten", "Set Text enabled on Display.")
  , m_matrix(matrix)
  { }

  virtual ~MatrixDbgCmd_TxtEna() { }

  void execute(unsigned int argc, const char **args, unsigned int idxToFirstArgToHandle)
  {
    if (0 != m_matrix)
    {
      if (argc - idxToFirstArgToHandle == 0)
      {
        Serial.print("Printing Text on Display is ");
        Serial.println(m_matrix->isPrintText() ? "enabled" : "disabled");
      }
      else if (argc - idxToFirstArgToHandle == 1)
      {
        bool printText = atoi(args[idxToFirstArgToHandle]);
        m_matrix->setIstPrintText(printText);
        Serial.print("Printing Text on Display is ");
        Serial.println(m_matrix->isPrintText() ? "enabled" : "disabled");
      }
      else
      {
        printUsage();
      }
    }
  }

  void printUsage()
  {
    Serial.println("");
    Serial.println(getHelpText());
    Serial.println("");
    Serial.println("usage: dbg matrix txten [{0|1}]");
    Serial.println("");
    Serial.println("           0:  Text overlay not shown");
    Serial.println("           1:  Text overlay shown");
    Serial.println("               optional parameter, shows current state if omitted");
    Serial.println("");
  }

private:  // forbidden functions
  MatrixDbgCmd_TxtEna();                                            // default constructor
  MatrixDbgCmd_TxtEna(const MatrixDbgCmd_TxtEna& src);              // copy constructor
  MatrixDbgCmd_TxtEna& operator = (const MatrixDbgCmd_TxtEna& src); // assignment operator
};

//-----------------------------------------------------------------------------

class HeartAnimationTimerAdapter : public TimerAdapter
{
private:
  MemphisMatrixDisplay* m_matrixDisplay;
public:
  HeartAnimationTimerAdapter(MemphisMatrixDisplay* matrixDisplay)
  : m_matrixDisplay(matrixDisplay)
  { }

  void timeExpired()
  {
    if (0 != m_matrixDisplay)
    {
      m_matrixDisplay->showNextFrame();
    }
  }
};

//-----------------------------------------------------------------------------

class MyCmdSeqAdapter : public CmdAdapter
{
private:
  MemphisMatrixDisplay* m_matrix;

public:
  MyCmdSeqAdapter(MemphisMatrixDisplay* matrix)
  : m_matrix(matrix)
  { }

  void stopAction()
  {
    if (0 != m_matrix)
    {
      m_matrix->deactivateDisplay();
    }
  }

  void selectImageAction(int image)
  {
    if (0 != m_matrix)
    {
      Serial.print("selectImageAction() - image: ");
      Serial.println(image);
      m_matrix->selectImage(image);
    }
  }

  void blankDisplayAction()
  {
    if (0 != m_matrix)
    {
      m_matrix->blankDisplay();
    }
  }
};

//-----------------------------------------------------------------------------

class CmdShowImage : public Cmd
{
private:
  unsigned int m_imge;
  static const long int c_waitForever = -1;

public:
  CmdShowImage(CmdSequence* cmdSeq, const char* name, unsigned int imge)
  : Cmd(cmdSeq, c_waitForever, name)
  , m_imge(imge)
  { }

  void execute()
  {
    if (0 != cmdSequence())
    {
      MyCmdSeqAdapter* adapter = static_cast<MyCmdSeqAdapter*>(cmdSequence()->adapter());
      if (0 != adapter)
      {
        adapter->selectImageAction(m_imge);
      }
    }
  }

  void leave()
  {
    MyCmdSeqAdapter* adapter = static_cast<MyCmdSeqAdapter*>(cmdSequence()->adapter());
    if (0 != adapter)
    {
      adapter->blankDisplayAction();
    }
  }

private: // forbidden default functions
  CmdShowImage();                                     // default constructor
  CmdShowImage& operator = (const CmdShowImage& src); // assignment operator
  CmdShowImage(const CmdShowImage& src);              // copy constructor
};

//-----------------------------------------------------------------------------

typedef enum
{
  CS_red   = 0,
  CS_green = 1,
  CS_blue  = 2,
  CS_NColors
} ColorSelection;

const uint16_t colors[] =
{ Adafruit_NeoMatrix::Color(255, 0, 0), Adafruit_NeoMatrix::Color(0, 255, 0), Adafruit_NeoMatrix::Color(0, 0, 255) };

// Animated-Heart ERNI
#define heartbeating2NUM_FRM 8
// [heartbeating2NUM_FRM][CS_NColors][MemphisMatrixDisplay::s_matrixEdgeLength * MemphisMatrixDisplay::s_matrixEdgeLength]
const unsigned char heartbeating2Frame[][CS_NColors][MemphisMatrixDisplay::s_matrixEdgeLength * MemphisMatrixDisplay::s_matrixEdgeLength] =
{
  {
    {0,0,0,0,0,0,0,0,0,0,0,0,0,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0,0},
    {0,0,0,0,0,0,0,0,0,0,0,0,0,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0,0},
    {0,0,0,0,0,0,0,0,0,0,0,0,0,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0,0}
  },
  {
    {0,0,3,3,3,3,0,0,0,0,3,3,3,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0,0},
    {0,0,55,55,55,55,0,0,0,0,55,55,55,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0,0},
    {0,0,120,120,120,120,0,0,0,0,120,120,120,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0,0}
  },
  {
    {0,0,0,0,0,0,0,0,0,0,0,0,0,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0,0},
    {0,0,0,0,0,0,0,0,0,0,0,0,0,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0,0},
    {0,0,0,0,0,0,0,0,0,0,0,0,0,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0,0}
  },
  {
    {0,0,3,3,3,3,0,0,0,0,3,3,3,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0,0},
    {0,0,55,55,55,55,0,0,0,0,55,55,55,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0,0},
    {0,0,120,120,120,120,0,0,0,0,120,120,120,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0,0}
  },
  {
    {0,0,0,0,0,0,0,0,0,0,0,0,0,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0,0},
    {0,0,0,0,0,0,0,0,0,0,0,0,0,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0,0},
    {0,0,0,0,0,0,0,0,0,0,0,0,0,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0,0}
  },
  {
    {0,0,3,3,3,3,0,0,0,0,3,3,3,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0,0},
    {0,0,55,55,55,55,0,0,0,0,55,55,55,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0,0},
    {0,0,120,120,120,120,0,0,0,0,120,120,120,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0,0}
  },
  {
    {0,0,3,3,3,3,0,0,0,0,3,3,3,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0,0},
    {0,0,55,55,55,55,0,0,0,0,55,55,55,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0,0},
    {0,0,120,120,120,120,0,0,0,0,120,120,120,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0,0}
  },
  {
    {0,0,3,3,3,3,0,0,0,0,3,3,3,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0,0},
    {0,0,55,55,55,55,0,0,0,0,55,55,55,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0,0},
    {0,0,120,120,120,120,0,0,0,0,120,120,120,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0,0}
  }
};

// Animated-Heart SBB
#define heartbeating3NUM_FRM 8
// [heartbeating3NUM_FRM][CS_NColors][MemphisMatrixDisplay::s_matrixEdgeLength * MemphisMatrixDisplay::s_matrixEdgeLength]
const unsigned char heartbeating3Frame[][CS_NColors][MemphisMatrixDisplay::s_matrixEdgeLength * MemphisMatrixDisplay::s_matrixEdgeLength] =
{
  {
    {0,0,0,0,0,0,0,0,0,0,0,0,0,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0,0},
    {0,0,0,0,0,0,0,0,0,0,0,0,0,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0,0},
    {0,0,0,0,0,0,0,0,0,0,0,0,0,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0,0}
  },
  {
    {0,0,237,237,237,237,0,0,0,0,237,237,237,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0,0},
    {0,0,27,27,27,27,0,0,0,0,27,27,27,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0,0},
    {0,0,52,52,52,52,0,0,0,0,52,52,52,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0,0}
  },
  {
    {0,0,0,0,0,0,0,0,0,0,0,0,0,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0,0},
    {0,0,0,0,0,0,0,0,0,0,0,0,0,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0,0},
    {0,0,0,0,0,0,0,0,0,0,0,0,0,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0,0}
  },
  {
    {0,0,237,237,237,237,0,0,0,0,237,237,237,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0,0},
    {0,0,27,27,27,27,0,0,0,0,27,27,27,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0,0},
    {0,0,52,52,52,52,0,0,0,0,52,52,52,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0,0}
  },
  {
    {0,0,0,0,0,0,0,0,0,0,0,0,0,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0,0},
    {0,0,0,0,0,0,0,0,0,0,0,0,0,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0,0},
    {0,0,0,0,0,0,0,0,0,0,0,0,0,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0,0}
  },
  {
    {0,0,237,237,237,237,0,0,0,0,237,237,237,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0,0},
    {0,0,27,27,27,27,0,0,0,0,27,27,27,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0,0},
    {0,0,52,52,52,52,0,0,0,0,52,52,52,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0,0}
  },
  {
    {0,0,237,237,237,237,0,0,0,0,237,237,237,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0,0},
    {0,0,27,27,27,27,0,0,0,0,27,27,27,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0,0},
    {0,0,52,52,52,52,0,0,0,0,52,52,52,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0,0}
  },
  {
    {0,0,237,237,237,237,0,0,0,0,237,237,237,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0,0},
    {0,0,27,27,27,27,0,0,0,0,27,27,27,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0,0},
    {0,0,52,52,52,52,0,0,0,0,52,52,52,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0,0}
  }
};

MemphisMatrixDisplay::MemphisMatrixDisplay(uint8_t pin)
: m_neoMatrix(new Adafruit_NeoMatrix(16, 16, pin, NEO_MATRIX_TOP + NEO_MATRIX_LEFT + NEO_MATRIX_COLUMNS + NEO_MATRIX_ZIGZAG, NEO_GRB + NEO_KHZ800))
, m_heartBeatRate(0)
, m_heartAnimationTimer(new Timer(new HeartAnimationTimerAdapter(this), Timer::IS_RECURRING))
, m_frame(0)
, m_isDisplayActive(false)
, m_selectedImage(0)
, m_imageSequence(new CmdSequence(new MyCmdSeqAdapter(this)))
, m_printText(false)
, m_dbgCliTopicMatrix(new DbgCli_Topic(DbgCli_Node::RootNode(), "matrix", "Display Matrix."))
, m_dbgCliSelImageCmd(new MatrixDbgCmd_SelImage(this))
, m_dbgCliRunSequenceCmd(new MatrixDbgCmd_RunSequence(this))
, m_dbgCliTxtEnaCmd(new MatrixDbgCmd_TxtEna(this))
{
  if (0 != m_neoMatrix)
  {
    m_neoMatrix->begin();
    m_neoMatrix->setTextWrap(false);
    m_neoMatrix->setBrightness(20);
    m_neoMatrix->setFont(&TomThumb);
    m_neoMatrix->setTextColor(colors[CS_blue]);
  }
  selectImage(m_selectedImage);
  prepareImageSequence();
  m_imageSequence->stop();
}

MemphisMatrixDisplay::~MemphisMatrixDisplay()
{
  delete m_heartAnimationTimer->adapter();
  m_heartAnimationTimer->attachAdapter(0);

  delete m_heartAnimationTimer;
  m_heartAnimationTimer = 0;

  delete m_neoMatrix;
  m_neoMatrix = 0;
}

void MemphisMatrixDisplay::prepareImageSequence()
{
  new CmdShowImage(m_imageSequence, "ERNIHeart1", 2);
  new CmdStop(m_imageSequence, 2);
  new CmdShowImage(m_imageSequence, "ERNIHeart2", 2);
  new CmdStop(m_imageSequence, 2);
  new CmdShowImage(m_imageSequence, "SBBHeart1",  3);
  new CmdStop(m_imageSequence, 2);
  new CmdShowImage(m_imageSequence, "SBBHeart2", 3);
  Cmd* lastCmd = new CmdStop(m_imageSequence, 2);
  lastCmd->setNext(m_imageSequence->getFirstCmd());
}

CmdSequence* MemphisMatrixDisplay::imageSequence()
{
  return m_imageSequence;
}

void MemphisMatrixDisplay::setHeartBeatRate(unsigned int heartBeatRate)
{
  m_heartBeatRate = heartBeatRate;
  const unsigned int numFrm = (m_selectedImage == 2) ? heartbeating2NUM_FRM :
                              (m_selectedImage == 3) ? heartbeating3NUM_FRM : 0;
  if (0 != m_heartAnimationTimer)
  {
    if (0 != m_heartBeatRate)
    {
	    // Fix division by zero bug!
      const unsigned long timeMillis = (60000 / m_heartBeatRate) / numFrm;
      m_heartAnimationTimer->startTimer(timeMillis);
    }
    else
    {
      m_heartAnimationTimer->cancelTimer();
    }
  }
  updateDisplay();
}

void MemphisMatrixDisplay::showFirstFrame()
{
  m_frame = 0;
  updateDisplay();
}

void MemphisMatrixDisplay::showNextFrame()
{
  m_frame++;
  if (0 == (m_frame % ((m_selectedImage == 2) ? heartbeating2NUM_FRM : heartbeating3NUM_FRM)))
  {
    if (m_imageSequence->isRunning())
    {
      m_frame = 0;
      m_imageSequence->execNextCmd();
    }
  }
  updateDisplay();
}

void MemphisMatrixDisplay::updateDisplay()
{
  if (m_isDisplayActive)
  {
    if (0 != m_neoMatrix)
    {
      m_neoMatrix->fillScreen(0);
      updateHeart();
      if (m_printText)
      {
        updateText();
      }
      m_neoMatrix->show();
    }
    else
    {
      deactivateDisplay();
    }
  }
}

void MemphisMatrixDisplay::blankDisplay()
{
  m_neoMatrix->fillScreen(0);
  m_neoMatrix->show();
}

void MemphisMatrixDisplay::updateText()
{
  if (0 != m_neoMatrix)
  {
    m_neoMatrix->setCursor(0, 16);
    m_neoMatrix->print(String(m_heartBeatRate));
  }
}

uint16_t MemphisMatrixDisplay::drawRGB24toRGB565(byte r, byte g, byte b)
{
  if ((r == 3) && (g == 55) && (b == 120))
  {
    float corrR = r * 1.5; if (corrR > 255.0) corrR = 255.0; r = static_cast<byte>(corrR);
    float corrG = g * 1.5; if (corrG > 255.0) corrG = 255.0; g = static_cast<byte>(corrG);
    float corrB = b * 1.5; if (corrB > 255.0) corrB = 255.0; b = static_cast<byte>(corrB);
  }
  return ((r / 8) << 11) | ((g / 4) << 5) | (b / 8);
}

void MemphisMatrixDisplay::updateHeart()
{
  for (byte y = 0; y < s_matrixEdgeLength; y++)
  {
    for (byte x = 0; x < s_matrixEdgeLength; x++)
    {
      byte loc = x + y * s_matrixEdgeLength;
      if (0 != m_neoMatrix)
      {
        if ((m_selectedImage == 3) && (heartbeating3NUM_FRM > m_frame))
        {
          m_neoMatrix->drawPixel(x, y, drawRGB24toRGB565(
                  heartbeating3Frame[m_frame][CS_red][loc],
                  heartbeating3Frame[m_frame][CS_green][loc],
                  heartbeating3Frame[m_frame][CS_blue][loc]));
        }
        else if ((m_selectedImage == 2) && (heartbeating2NUM_FRM > m_frame))
        {
          m_neoMatrix->drawPixel(x, y, drawRGB24toRGB565(
                  heartbeating2Frame[m_frame][CS_red][loc],
                  heartbeating2Frame[m_frame][CS_green][loc],
                  heartbeating2Frame[m_frame][CS_blue][loc]));
        }
      }
    }
  }
}

void MemphisMatrixDisplay::selectImage(unsigned int img)
{
  m_selectedImage = img;
  if ((0 == m_selectedImage) || (1 == m_selectedImage) || (3 < m_selectedImage))
  {
    m_selectedImage = 0;
    m_imageSequence->stop();
    deactivateDisplay();
    Serial.println("selectImage() -> deactivateDisplay()");
  }
  else
  {
    showFirstFrame();
    activateDisplay();
    Serial.println("selectImage() -> activateDisplay()");
  }
}

unsigned int MemphisMatrixDisplay::selectedImage()
{
  return m_selectedImage;
}


bool MemphisMatrixDisplay::isPrintText()
{
  return m_printText;
}

void MemphisMatrixDisplay::setIstPrintText(bool isPrintText)
{
  m_printText = isPrintText;
}

void MemphisMatrixDisplay::activateDisplay()
{
  m_isDisplayActive = true;
  pinMode(c_displayBlankPin, INPUT);
  digitalWrite(c_displayBlankPin, 1);
  updateDisplay();
}

void MemphisMatrixDisplay::deactivateDisplay()
{
  m_isDisplayActive = false;
  pinMode(c_displayBlankPin, OUTPUT);
  digitalWrite(c_displayBlankPin, 0);
  if (0 != m_neoMatrix)
  {
    m_neoMatrix->fillScreen(0);
    m_neoMatrix->show();
  }
}
